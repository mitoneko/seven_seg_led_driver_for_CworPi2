// definitions for Seven segment LED for CrowPi2
/dts-v1/;
/plugin/;

/ {
    .compatible = "brcm,bcm2835";

    fragment@0 {
        target = <&i2c1>;
        __overlay__ {
            #address-cells = <1>;
            #size-cells = <0>;
            sevenseg: sevenseg {
                compatible = "CrowPi2,SevenSegmentLed";
                reg = <0x70>;
                status = "okay";
            };
        };
    };
};
